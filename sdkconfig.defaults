## sdkconfig.defaults
```kconfig
CONFIG_IDF_TARGET="esp32s3"

CONFIG_FREERTOS_HZ=1000

CONFIG_IDF_EXPERIMENTAL_FEATURES=y

CONFIG_SPI_FLASH_UNDER_HIGH_FREQ=y
CONFIG_SPI_FLASH_HPM_ENA=y
CONFIG_SPI_FLASH_ROM_IMPL=y

# disable interrupt watchdog
CONFIG_ESP_INT_WDT=n
CONFIG_ESP_TASK_WDT_EN=n

# set compiler optimization level to -O2 (compile for performance)
CONFIG_COMPILER_OPTIMIZATION_PERF=y

CONFIG_ESPTOOLPY_FLASHSIZE_16MB=y
CONFIG_ESPTOOLPY_FLASHSIZE="16MB"
 # over twice as fast as DIO
CONFIG_ESPTOOLPY_FLASHMODE_QIO=y
CONFIG_ESPTOOLPY_FLASHFREQ_120M=y

# ESP32-specific
#
CONFIG_ESP_DEFAULT_CPU_FREQ_MHZ_240=y
CONFIG_ESP_DEFAULT_CPU_FREQ_MHZ=240

# Common ESP-related
#
CONFIG_ESP_SYSTEM_EVENT_TASK_STACK_SIZE=4096
CONFIG_ESP_MAIN_TASK_STACK_SIZE=16384

# SPIRAM Configuration
CONFIG_SPIRAM=y
CONFIG_SPIRAM_USE_MALLOC=y
CONFIG_SPIRAM_MODE_OCT=y
CONFIG_SPIRAM_SPEED_120M=y
CONFIG_SPIRAM_SPEED=120
CONFIG_SPIRAM_FETCH_INSTRUCTIONS=y
CONFIG_SPIRAM_RODATA=y
# anything larger than this is attempted to allocate within SPIRAM first
CONFIG_SPIRAM_MALLOC_ALWAYSINTERNAL=0
# specifcally reserved internally for DMA
CONFIG_SPIRAM_MALLOC_RESERVE_INTERNAL=262144
# CONFIG_SPIRAM_ALLOW_BSS_SEG_EXTERNAL_MEMORY=y

CONFIG_I2S_ISR_IRAM_SAFE=y
CONFIG_I2C_ISR_IRAM_SAFE=y
CONFIG_GDMA_CTRL_FUNC_IN_IRAM=y
CONFIG_GDMA_ISR_IRAM_SAFE=y
CONFIG_ESP_IPC_USES_CALLERS_PRIORITY=n
```
